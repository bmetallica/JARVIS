## deploy/satellite-esp/sdkconfig.defaults
```kconfig
# ESP32-S3 + 8MB Octal-PSRAM (Waveshare ESP32-S3-AUDIO-Board)
CONFIG_IDF_TARGET="esp32s3"
CONFIG_ESP32S3_SPIRAM_SUPPORT=y
CONFIG_SPIRAM=y
CONFIG_SPIRAM_MODE_OCT=y
CONFIG_SPIRAM_SPEED_80M=y
CONFIG_ESPTOOLPY_FLASHSIZE_16MB=y

# Eigene Partitionstabelle (OTA + Wake-Word-Modell)
CONFIG_PARTITION_TABLE_CUSTOM=y
CONFIG_PARTITION_TABLE_CUSTOM_FILENAME="partitions.csv"

CONFIG_ESP_MAIN_TASK_STACK_SIZE=8192
CONFIG_FREERTOS_HZ=1000

# 240 MHz: nötig, damit die 2-Mikrofon-AFE (BSS+VAD+WakeNet+AGC) in Echtzeit läuft.
# Bei 160 MHz hinkt der interne AFE-Task hinterher → FEED-Ringbuffer-Overflow.
CONFIG_ESP_DEFAULT_CPU_FREQ_MHZ_240=y
CONFIG_ESP_DEFAULT_CPU_FREQ_MHZ=240

# esp-sr: Wake-Word-Modell „hey_jarvis", AFE im PSRAM
# (im menuconfig unter „ESP Speech Recognition" auswählen)
CONFIG_SR_WN_WN9_HEYJARVIS=y
CONFIG_SR_WN_MODEL_LOAD_FROM_FLASH=y
CONFIG_ESP_TLS_INSECURE=y
CONFIG_ESP_TLS_SKIP_SERVER_CERT_VERIFY=y
CONFIG_SR_WN_WN9_JARVIS_TTS=y
```
